## Kconfig.projbuild
```kconfig
menu "Component drv_ds18b20 Configuration"

    config DRV_DS18B20_USE
        bool "Use drv_ds18b20 (digital outputs) component"
        default y

    config DRV_DS18B20_GPIO_RANGE_MIN
        int "GPIO Minimum"
        default 0
        depends on DRV_DS18B20_USE

    config DRV_DS18B20_WAIT_INIT_MS
        int "Time Wait Blocking Initialization Complete"
        default 0
        depends on DRV_DS18B20_USE

    config DRV_DS18B20_GPIO_RANGE_NONE
        int "GPIO Not Used"
        default -1
        depends on DRV_DS18B20_USE

    config DRV_DS18B20_GPIO_OUT_RANGE_MAX
        int "Output GPIO Maximum"
        default 33 if IDF_TARGET_ESP32
        default 46 if IDF_TARGET_ESP32S2
        default 19 if IDF_TARGET_ESP32C3
        default 48 if IDF_TARGET_ESP32S3
        depends on DRV_DS18B20_USE

    config DRV_DS18B20_ONE_WIRE_GPIO_0
        int "OneWire channel 0 GPIO number"
        range DRV_DS18B20_GPIO_RANGE_NONE DRV_DS18B20_GPIO_OUT_RANGE_MAX
        default -1
        help
            GPIO number (IOxx) to access One Wire Bus.

            Some GPIOs are used for other purposes (flash connections, etc.) and cannot be used.

            GPIOs 34-39 are input-only so cannot be used to drive the One Wire Bus.
        depends on DRV_DS18B20_USE

    config DRV_DS18B20_ONE_WIRE_GPIO_1
        int "OneWire channel 1 GPIO number"
        range DRV_DS18B20_GPIO_RANGE_NONE DRV_DS18B20_GPIO_OUT_RANGE_MAX
        default -1
        help
            GPIO number (IOxx) to access One Wire Bus.

            Some GPIOs are used for other purposes (flash connections, etc.) and cannot be used.

            GPIOs 34-39 are input-only so cannot be used to drive the One Wire Bus.
        depends on DRV_DS18B20_USE

    config DRV_DS18B20_ONE_WIRE_GPIO_2
        int "OneWire channel 2 GPIO number"
        range DRV_DS18B20_GPIO_RANGE_NONE DRV_DS18B20_GPIO_OUT_RANGE_MAX
        default -1
        help
            GPIO number (IOxx) to access One Wire Bus.

            Some GPIOs are used for other purposes (flash connections, etc.) and cannot be used.

            GPIOs 34-39 are input-only so cannot be used to drive the One Wire Bus.
        depends on DRV_DS18B20_USE

    config DRV_DS18B20_ENABLE_STRONG_PULLUP_GPIO
        bool "Enable strong pull-up controlled by GPIO (MOSFET)"
        default n
        help
            An external circuit can be used to provide a strong pull-up to the One Wire Bus.
            This is useful when the bus has parasitic-powered devices and extra current is
            required to power them, such as during temperature ADC conversions.

            An example of such a circuit for the ESP32 is a P-channel MOSFET (such as the BS250)
            connected Source-to-Drain between a current-limiting resistor (e.g. 270ohm for 12mA
            max at 3.3V), itself connected to VCC, and the One Wire Bus data line. The Gate is
            connected to the GPIO specified here.
        depends on DRV_DS18B20_USE

    config DRV_DS18B20_STRONG_PULLUP_GPIO
        int "Strong pull-up GPIO number"
        range DRV_DS18B20_GPIO_RANGE_NONE DRV_DS18B20_GPIO_OUT_RANGE_MAX
        default -1
        help
            GPIO number (IOxx) to control the strong pull-up on the One Wire Bus, perhaps
            via a P-channel MOSFET between VCC and the One Wire Bus data line.

            This GPIO will be set as an output and driven high during temperature conversion.
            This would enable the MOSFET providing current to the devices.

            At all other times it will be driven low, switching off the MOSFET and allowing
            the One Wire Bus to operate normally.

            Some GPIOs are used for other purposes (flash connections, etc.) and cannot be used.

            GPIOs 34-39 are input-only so cannot be used to drive the One Wire Bus.
        depends on DRV_DS18B20_ENABLE_STRONG_PULLUP_GPIO

endmenu
```
